## main/Kconfig.projbuild
```kconfig
menu "Shelly Config"

    orsource "$IDF_PATH/examples/common_components/env_caps/$IDF_TARGET/Kconfig.env_caps"

    config SHELLY_WIFI_SSID
        string "WiFi SSID"
        default "myssid"
        help
            SSID (network name) for the example to connect to.

    config SHELLY_WIFI_PASSWORD
        string "WiFi Password"
        default "mypassword"
        help
            WiFi password (WPA or WPA2) for the example to use.

    config SHELLY_FIRMWARE_UPG_URL
        string "Firmware Upgrade URL"
        default "http://192.168.2.106:8070/shelly-ctrl.bin"
        help
            URL of server which hosts the firmware image.

    config SHELLY_OTA_RECV_TIMEOUT
        int "OTA Receive Timeout"
        default 5000
        help
            Maximum time for reception

    config SHELLY_BROKER_URL
        string "MQTT Broker URL"
        default "mqtt://mqtt.eclipseprojects.io"
        help
            URL of the broker to connect to
endmenu
```

## sdkconfig.defaults
```kconfig
CONFIG_PARTITION_TABLE_CUSTOM=y
CONFIG_ESPTOOLPY_FLASHSIZE_8MB=y
CONFIG_ESP_DEFAULT_CPU_FREQ_MHZ_240=y
CONFIG_FREERTOS_HZ=1000
CONFIG_MQTT_TRANSPORT_WEBSOCKET=n
CONFIG_MQTT_MSG_ID_INCREMENTAL=y
```
